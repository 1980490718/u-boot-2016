## arch/arm/cpu/armv7/qca/common/Kconfig
```kconfig
config QCA_COMMON
	bool "QCA Common IPs"

config MACADDR_MODIFY
	bool "Support MAC address modification via ART partition"
	depends on QCA_COMMON
	default y
	help
	  Enable writing MAC addresses to the ART calibration data partition.
	  This allows the failsafe HTTP server to modify device MAC addresses
	  through the web interface. The XOR16 checksum is recalculated
	  automatically after modification.

config SKIP_RESET
	bool "Skip reset after crash dump"
	default n
```
