## board/ipq40xx/Kconfig
```kconfig
if ARCH_IPQ40xx

config BOARD_DISPLAY_NAME
	string "Name to display in U-Boot boot message"
	depends on OF_CONTROL
	help
		Define the product name to display in U-Boot startup message.
		This will appear in the 'Model:' line of the boot output.

config DISPLAY_BOARDINFO
	bool "Display board info"
	default y

config SYS_CPU
	default "ipq40xx"

config SYS_BOARD
	default "ipq40xx"

config SYS_VENDOR
	default "qca/arm"

config SYS_CONFIG_NAME
	default "ipq40xx"

config IPQ40XX_I2C
	bool "ipq40xx i2c"

config USB_XHCI_IPQ
	bool "ipq40xx usb"

config PCI_IPQ
	bool "ipq40xx pci"

config BOARD_TYPES
	bool "Support board_type member in global data"
	default y

config IPQ40XX_ALIYUN_AP4220
	bool "For ipq40xx aliyun ap4220 support"
	default n
		help
			Enable support for ipq40xx aliyun ap4220 board.

config IPQ40XX_THINKPLUS_FOGPOD800
	bool "For ipq40xx thinkplus fogpod800 support"
	default n
		help
			Enable support for ipq40xx thinkplus fogpod800 board.

config IPQ40XX_P2W_R619AC
	bool "For ipq40xx p2w r619ac support"
	default n
		help
			Enable support for ipq40xx p2w r619ac board.
endif
```

## board/ipq6018/Kconfig
```kconfig
if ARCH_IPQ6018

config SYS_CPU
       default "ipq6018"

config SYS_BOARD
       default "ipq6018"

config SYS_VENDOR
       default "qca/arm"

config SYS_CONFIG_NAME
       default "ipq6018"

config USB_XHCI_IPQ
	bool "Enable usb support for ipq6018"

config PCI_IPQ
	bool "Enable pci support for ipq6018"

config IPQ6018_QCA_AQUANTIA_PHY
	bool "Enable Aquantia PHY support for ipq6018"

config BOARD_TYPES
	bool "Support board_type member in global data"
	default y

config LIST_OF_CONFIG_NAMES_SUPPORT
	bool "List of config names support"

config LIST_FUSE
	bool "Enable fuse list command"
	default n

config IPQ6018_M2
	bool "IPQ6018 M2 Board"
	select 256MB_RAM
	default n
	help
		Enable support for IPQ6018_M2 board

config IPQ6018_360V6
	bool "IPQ6018 360V6 Board Support"
	default n
	help
		Enable support for IPQ6018_360V6 board

config IPQ6018_AX5_JDCLOUD
	bool "IPQ6018 AX5 JDCloud Board Support"
	default n
	help
		Enable support for IPQ6018_AX5_JDCLOUD board

config IPQ6018_JDCLOUD_AX6600
	bool "IPQ6018 JDCloud AX6600 Board Support"
	default n
	help
		Enable support for IPQ6018_JDCLOUD_AX6600 board

config IPQ6018_JDCLOUD_ER1
	bool "IPQ6018 JDCloud ER1 Board Support"
	default n
	help
		Enable support for IPQ6018_JDCLOUD_ER1 board

config IPQ6018_XIAOMI_AX1800
	bool "IPQ6018 Xiaomi AX1800 Board Support"
	select 256MB_RAM
	default n
	help
		Enable support for IPQ6018_XIAOMI_AX1800 board

config IPQ6018_NN6000
	bool "IPQ6018 NN6000 Board Support"
	default n
	help
		Enable support for IPQ6018_NN6000 board

config 256MB_RAM
	bool "Board has only 256MB RAM"
	default n
	help
	  Select this if your board has only 256MB RAM installed
endif
```

## board/ipq806x/Kconfig
```kconfig
if ARCH_IPQ806x

config BOARD_DISPLAY_NAME
	string "Name to display in U-Boot boot message"
	depends on OF_CONTROL
	help
		Define the product name to display in U-Boot startup message.
		This will appear in the 'Model:' line of the boot output.

config DISPLAY_BOARDINFO
	bool "Display board info"
	default y

config SYS_CPU
	default "ipq806x"

config SYS_BOARD
	default "ipq806x"

config SYS_VENDOR
	default "qca/arm"

config SYS_CONFIG_NAME
	default "ipq806x"
config IPQ806X_I2C
	bool "ipq806x i2c"

config USB_XHCI_IPQ
	bool "ipq806x usb"

config PCI_IPQ
	bool "ipq806x pci"

config BOARD_TYPES
	bool "Support board_type member in global data"
	default y

endif
```

## board/ipq807x/Kconfig
```kconfig
config SYS_CPU
       default "ipq807x"

config SYS_BOARD
       default "ipq807x"

config SYS_VENDOR
       default "qca/arm"

config SYS_CONFIG_NAME
       default "ipq807x"

config IPQ_I2C
	bool "Enable i2c support on IPQ platform"

config USB_XHCI_IPQ
	bool "ipq807x usb support for ipq807x"

config PCI_IPQ
	bool "ipq807x pci support for ipq807x"

config QCA_AQUANTIA_PHY
	bool "Enable Aquantia PHY support for ipq807x"

config QCA8033_PHY
	bool "Enable QCA8033 PHY support for ipq807x"

config QCA8081_PHY
	bool "Enable QCA8081 PHY support for ipq807x"

config QCA8075_PHY
	bool "Enable QCA8075 PHY support for ipq807x"

config BOARD_TYPES
	bool "Support board_type member in global data"
	default y

config LIST_OF_CONFIG_NAMES_SUPPORT
	bool "List of config names support"

config LIST_FUSE
	bool "Enable fuse list command"
	default n

config IPQ807X_ALIYUN_AP8220
	bool "IPQ807x ALIYUN AP8220 board support"
	default n
	help
	  Enable support for IPQ807x ALIYUN AP8220 board

config IPQ807X_REDMI_AX6
	bool "IPQ807x REDMI AX6 board support"
	default n
	help
	  Enable support for IPQ807x REDMI AX6 board

config IPQ807X_XGLINK_5GCPE
	bool "IPQ807x XGLINK 5GCPE board support"
	default n
	help
	  Enable support for IPQ807x XGLINK 5GCPE board
	  
config IPQ807X_SOFTBANK_AIR5
	bool "IPQ807x SoftBank Air5 board support"
	default n
	help
	  Enable support for SoftBank Air5 (IPQ8072A) board.
	  Uses W25R512NWEIQ 64MB SPI-NOR flash.

config SOFTBANK_AIR5_BOOT
	bool "SoftBank Air5 direct OpenWrt boot"
	depends on IPQ807X_SOFTBANK_AIR5
	default n
	help
	  Enable Air5-specific boot command (bootopenwrt) and
	  web failsafe recovery via built-in httpd.
	  Replaces bootipq with direct FIT image boot from 0x00400000.

config DISABLE_SIGNED_BOOT
	bool "Disable Qualcomm signed boot verification"
	default n
	help
	  Skip SCM-based signature verification on APPSBL load.
	  Required for custom U-Boot on devices without secure boot fuses blown.
```

## board/ipq9574/Kconfig
```kconfig
if ARCH_IPQ9574

config SYS_CPU
       default "ipq9574"

config SYS_BOARD
       default "ipq9574"

config SYS_VENDOR
       default "qca/arm"

config SYS_CONFIG_NAME
       default "ipq9574"

config IPQ9574_QCA_AQUANTIA_PHY
	bool "Enable Aquantia PHY support for ipq9574"

config IPQ9574_QCA8075_PHY
	bool "Enable Malibu PHY support for ipq9574"

config BOARD_TYPES
	bool "Support board_type member in global data"
	default y
endif
```

## configs/ipq807x_softbank_air5_defconfig
```kconfig
# SoftBank Air5 (IPQ8072A) - OpenWrt Direct Boot Configuration
# Flash: W25R512NWEIQ 64MB 1.8V SPI-NOR
# Boot: Direct FIT image from 0x00400000 (no SMEM partition dependency)
#
# Based on ipq807x_defconfig. Key rules for this project:
#   - ipq807x.h uses legacy #define for many CONFIG_* symbols.
#   - Those same symbols must NOT be set =y in defconfig, or autoconf.h
#     will define them again and -Werror will fire on the redefinition.
#   - Affected symbols (already #defined in ipq807x.h unconditionally):
#       CONFIG_SYS_VSNPRINTF, CONFIG_SPI_FLASH, CONFIG_CMD_SF,
#       CONFIG_SPI_FLASH_{STMICRO,WINBOND,MACRONIX,GIGADEVICE},
#       CONFIG_SPI_FLASH_USE_4K_SECTORS, CONFIG_CMD_XIMG,
#       CONFIG_CMD_MEMTEST, CONFIG_CMD_PING, CONFIG_CMD_DHCP,
#       CONFIG_CMD_TFTPPUT, CONFIG_CMD_RUN
#   - CONFIG_SHA1 / CONFIG_SHA256: defined by include/image.h when FIT=y,
#     must also remain unset in Kconfig.

# --- Architecture ---
CONFIG_ARM=y
CONFIG_HAS_VBAR=y
CONFIG_CPU_V7=y
CONFIG_ARCH_IPQ807x=y
CONFIG_SYS_MALLOC_F_LEN=0x400
CONFIG_SYS_MALLOC_F=y
CONFIG_DM_SERIAL=y

# --- Air5 board identity ---
CONFIG_DEFAULT_DEVICE_TREE="ipq807x-hk09"
CONFIG_IPQ807X_HK09=y
CONFIG_SOFTBANK_AIR5_BOOT=y
CONFIG_IPQ807X_SOFTBANK_AIR5=y
CONFIG_DISABLE_SIGNED_BOOT=y
CONFIG_SYS_TEXT_BASE=0x4A900000

CONFIG_LOCALVERSION=""
CONFIG_LOCALVERSION_AUTO=y
CONFIG_CC_OPTIMIZE_FOR_SIZE=y
CONFIG_EXPERT=y
CONFIG_SYS_MALLOC_CLEAR_ON_INIT=y
CONFIG_FIT=y
CONFIG_FIT_VERBOSE=y
# CONFIG_FIT_SIGNATURE is not set
CONFIG_SYS_EXTRA_OPTIONS=""
CONFIG_SYS_PROMPT="Air5# "

# Info commands
CONFIG_CMD_BDI=y
# CONFIG_CMD_CONSOLE is not set

# Boot commands
# CONFIG_CMD_BOOTD is not set
CONFIG_CMD_BOOTM=y
CONFIG_CMD_BOOTZ=y
CONFIG_CMD_GO=y
# CONFIG_CMD_RUN is not set
# CONFIG_CMD_IMI is not set
# CONFIG_CMD_IMLS is not set
# CONFIG_CMD_XIMG is not set

# Environment commands
# CONFIG_CMD_EXPORTENV is not set
# CONFIG_CMD_IMPORTENV is not set
CONFIG_CMD_EDITENV=y
CONFIG_CMD_SAVEENV=y
CONFIG_CMD_ENV_EXISTS=y

# Memory commands
CONFIG_CMD_MEMORY=y
CONFIG_CMD_CRC32=y
# CONFIG_LOOPW is not set
# CONFIG_CMD_MEMTEST is not set
# CONFIG_CMD_MX_CYCLIC is not set
# CONFIG_CMD_MEMINFO is not set

# Device access commands
CONFIG_CMD_DM=y
# CONFIG_CMD_DEMO is not set
CONFIG_CMD_LOADB=y
CONFIG_CMD_LOADS=y
# CONFIG_CMD_FLASH is not set
# CONFIG_CMD_NAND is not set
# CONFIG_CMD_SF is not set
CONFIG_CMD_SPI=y
# CONFIG_CMD_I2C is not set
# CONFIG_CMD_USB is not set
# CONFIG_CMD_FPGA is not set

# Shell scripting commands
CONFIG_CMD_ECHO=y
CONFIG_CMD_ITEST=y
CONFIG_CMD_SOURCE=y
CONFIG_CMD_SETEXPR=y

# Network commands
CONFIG_CMD_NET=y
# CONFIG_CMD_TFTPPUT is not set
# CONFIG_CMD_TFTPSRV is not set
# CONFIG_CMD_RARP is not set
# CONFIG_CMD_DHCP is not set
# CONFIG_CMD_NFS is not set
# CONFIG_CMD_PING is not set
# CONFIG_CMD_CDP is not set
# CONFIG_CMD_SNTP is not set
# CONFIG_CMD_DNS is not set
# CONFIG_CMD_LINK_LOCAL is not set

# Network PHY - Air5 uses QCA8075 only
CONFIG_QCA8075_PHY=y
# CONFIG_QCA_AQUANTIA_PHY is not set
# CONFIG_QCA8033_PHY is not set
# CONFIG_QCA8081_PHY is not set

# Misc commands
# CONFIG_CMD_TIME is not set
CONFIG_CMD_MISC=y
CONFIG_CMD_PART=y
CONFIG_PARTITION_UUIDS=y
# CONFIG_CMD_TIMER is not set
# CONFIG_CMD_ELF is not set

# Boot timing
# CONFIG_BOOTSTAGE is not set
CONFIG_BOOTSTAGE_USER_COUNT=20
CONFIG_BOOTSTAGE_STASH_ADDR=0
CONFIG_BOOTSTAGE_STASH_SIZE=4096

# Security / Device Tree
CONFIG_SUPPORT_OF_CONTROL=y
CONFIG_OF_CONTROL=y
CONFIG_OF_BOARD_FIXUP=y
CONFIG_OF_SEPARATE=y
# CONFIG_OF_EMBED is not set
CONFIG_NET=y
# CONFIG_NET_RANDOM_ETHADDR is not set
# CONFIG_NETCONSOLE is not set

# Driver model
CONFIG_DM=y
CONFIG_DM_WARN=y
CONFIG_DM_DEVICE_REMOVE=y
CONFIG_DM_STDIO=y
CONFIG_DM_SEQ_ALIAS=y
# CONFIG_REGMAP is not set
# CONFIG_DEVRES is not set
CONFIG_SIMPLE_BUS=y
# CONFIG_CLK is not set
# CONFIG_CPU is not set
# CONFIG_FSL_CAAM is not set
# CONFIG_DFU_TFTP is not set
# CONFIG_LPC32XX_GPIO is not set
# CONFIG_VYBRID_GPIO is not set
# CONFIG_DM_I2C_COMPAT is not set
# CONFIG_CROS_EC_KEYB is not set
# CONFIG_IPQ_I2C is not set
# CONFIG_LED is not set
# CONFIG_CROS_EC is not set
# CONFIG_FSL_SEC_MON is not set
# CONFIG_PCA9551_LED is not set
# CONFIG_RESET is not set
# CONFIG_DM_MMC is not set

# NAND - DISABLED (pure SPI-NOR device)
# CONFIG_QPIC_NAND is not set
# CONFIG_NAND_DENALI is not set
# CONFIG_NAND_VF610_NFC is not set
# CONFIG_NAND_PXA3XX is not set

# SPI Flash - enable only the Kconfig-gated symbols.
# CMD_SF / SPI_FLASH / SPI_FLASH_* are already #defined in ipq807x.h
# so they must stay unset here to avoid redefinition errors.
CONFIG_QCA_SPI=y
# CONFIG_SPI_FLASH is not set
CONFIG_SPI_FLASH_BAR=y
CONFIG_IPQ_4B_ADDR_SWITCH_REQD=y

# CONFIG_DM_ETH is not set
# CONFIG_PHYLIB is not set
# CONFIG_NETDEVICES is not set

# PCI - disabled for faster boot
# CONFIG_DM_PCI is not set
# CONFIG_PCI_IPQ is not set

# CONFIG_PINCTRL is not set
# CONFIG_DM_PMIC is not set
# CONFIG_DM_REGULATOR is not set
# CONFIG_RAM is not set
# CONFIG_DM_RTC is not set

CONFIG_REQUIRE_SERIAL_CONSOLE=y
# CONFIG_DEBUG_UART is not set
# CONFIG_FSL_ESPI is not set
# CONFIG_TI_QSPI is not set
# CONFIG_DM_THERMAL is not set

# USB - disabled for faster boot
# CONFIG_USB is not set
# CONFIG_DM_USB is not set
# CONFIG_USB_XHCI_IPQ is not set

# CONFIG_VIDEO_VESA is not set

# Library routines
# CONFIG_CC_OPTIMIZE_LIBS_FOR_SPEED is not set
CONFIG_HAVE_PRIVATE_LIBGCC=y
# CONFIG_USE_PRIVATE_LIBGCC is not set
CONFIG_SYS_HZ=1000
# CONFIG_SYS_VSNPRINTF is not set
# CONFIG_REGEX is not set
# CONFIG_LIB_RAND is not set
# CONFIG_CMD_DHRYSTONE is not set
# CONFIG_RSA is not set
# CONFIG_TPM is not set

# Hashing - SHA1/SHA256 are defined by include/image.h when FIT=y,
# setting them here too causes -Werror redefinition. Keep unset.
# CONFIG_SHA1 is not set
# CONFIG_SHA256 is not set
# CONFIG_SHA_HW_ACCEL is not set

# Compression
# CONFIG_LZ4 is not set
CONFIG_LZMA=y
# CONFIG_ERRNO_STR is not set
# CONFIG_UNIT_TEST is not set
```
